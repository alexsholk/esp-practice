## 2025_05_28_rgb_led/main/Kconfig.projbuild
```kconfig
menu "Application Configuration"

    config RGB_LED_GPIO
        int "Addressable RGB LED GPIO pin"
        range 0 48
        default 48
        help
             GPIO pin for addressable RGB LED
endmenu
```

## 2025_06_20_lcd/main/Kconfig.projbuild
```kconfig
menu "Application Configuration"
    config I2C_BUS_PORT
        int "I2C Bus Port"
        range 0 1
        default 0
        help
            I2C Bus Port number

    config I2C_SCL_GPIO
        int "I2C clock GPIO pin"
        range 0 48
        default 6
        help
             GPIO pin for I2C clock

    config I2C_SDA_GPIO
        int "I2C data GPIO pin"
        range 0 48
        default 5
        help
             GPIO pin for I2C data
endmenu
```
